## arch/arm/mach-msm/Kconfig
```kconfig
if ARCH_MSM

choice
	prompt "Qualcomm MSM SoC Type"
	default ARCH_MSM7X00A
	depends on ARCH_MSM

config ARCH_MSM7X00A
	bool "MSM7x00A / MSM7x01A"
	select ARCH_MSM_ARM11
	select CPU_V6
	select GPIO_MSM_V1
	select MACH_TROUT if !MACH_HALIBUT
	select MSM_PROC_COMM
	select MSM_SMD
	select CLKSRC_QCOM
	select MSM_SMD_PKG3

config ARCH_MSM7X30
	bool "MSM7x30"
	select ARCH_MSM_SCORPION
	select CPU_V7
	select GPIO_MSM_V1
	select MACH_MSM7X30_SURF # if !
	select MSM_GPIOMUX
	select MSM_PROC_COMM
	select MSM_SMD
	select CLKSRC_QCOM
	select MSM_VIC

config ARCH_QSD8X50
	bool "QSD8X50"
	select ARCH_MSM_SCORPION
	select CPU_V7
	select GPIO_MSM_V1
	select MACH_QSD8X50_SURF if !MACH_QSD8X50A_ST1_5
	select MSM_GPIOMUX
	select MSM_PROC_COMM
	select MSM_SMD
	select CLKSRC_QCOM
	select MSM_VIC

endchoice

config MSM_SOC_REV_A
	bool

config  ARCH_MSM_ARM11
	bool

config  ARCH_MSM_SCORPION
	bool

config  MSM_VIC
	bool

menu "Qualcomm MSM Board Type"
	depends on ARCH_MSM

config MACH_HALIBUT
	depends on ARCH_MSM
	depends on ARCH_MSM7X00A
	bool "Halibut Board (QCT SURF7201A)"
	help
	  Support for the Qualcomm SURF7201A eval board.

config MACH_TROUT
	depends on ARCH_MSM
	depends on ARCH_MSM7X00A
	bool "HTC Dream (aka trout)"
	help
	  Support for the HTC Dream, T-Mobile G1, Android ADP1 devices.

config MACH_MSM7X30_SURF
	depends on ARCH_MSM7X30
	bool "MSM7x30 SURF"
	help
	  Support for the Qualcomm MSM7x30 SURF eval board.

config MACH_ARIESVE
	depends on ARCH_MSM7X30
	depends on !MSM_STACKED_MEMORY
	select APPSBOOT_3M_CONFIG
	default n
	bool "ARIESVE"
	help
	  Support for the Samsung Aries VE board.

config MACH_QSD8X50_SURF
	depends on ARCH_QSD8X50
	bool "QSD8x50 SURF"
	help
	  Support for the Qualcomm QSD8x50 SURF eval board.

config MACH_QSD8X50A_ST1_5
	depends on ARCH_QSD8X50
	bool "QSD8x50A ST1.5"
	select MSM_SOC_REV_A
	help
	  Support for the Qualcomm ST1.5.

endmenu

config APPSBOOT_3M_CONFIG
	bool

config MSM_SMD_PKG3
	bool

config MSM_PROC_COMM
	bool

config MSM_SMD
	bool

config MSM_GPIOMUX
	bool
	help
	  Support for MSM V1 TLMM GPIOMUX architecture.

config MSM_STACKED_MEMORY
	bool "Stacked Memory"
	default y
	help
	  This option is used to indicate the presence of on-die stacked
	  memory.  When present this memory bank is used for a high speed
	  shared memory interface.  When not present regular RAM is used.

config PHYS_OFFSET
	hex
	default "0x40800000" if ARCH_MSM9615
	default "0x80200000" if ARCH_APQ8064
	default "0x80200000" if ARCH_MSM8960
	default "0x80200000" if ARCH_MSM8930
	default "0x00000000" if ARCH_MSM8974
	default "0x00000000" if ARCH_MPQ8092
	default "0x00000000" if ARCH_MSM8226
	default "0x10000000" if ARCH_FSM9XXX
	default "0x20200000" if ARCH_MSM9625
	default "0x00200000" if !MSM_STACKED_MEMORY && !APPSBOOT_3M_CONFIG
	default "0x00400000" if !MSM_STACKED_MEMORY && APPSBOOT_3M_CONFIG
	default "0x00000000" if ARCH_QSD8X50 && MSM_SOC_REV_A
	default "0x20000000" if ARCH_QSD8X50
	default "0x40200000" if ARCH_MSM8X60
	default "0x10000000"

config MSM_ADSP
	depends on (ARCH_MSM7X01A || ARCH_MSM7X25 || ARCH_MSM7X27)
	tristate "MSM ADSP driver"
	depends on ANDROID_PMEM
	default y
	help
	  Provides access to registers needed by the userspace aDSP library.

config ADSP_RPC_VER
	hex
	default 0x30002 if (ARCH_MSM7X27 || (ARCH_MSM7X25 && AMSS_7X25_VERSION_2009))
	default 0x30001 if (ARCH_MSM7X01A || (ARCH_MSM7X25 && AMSS_7X25_VERSION_2008))
	depends on MSM_ADSP
	help
	  Select proper ADSP RPC version

choice
	prompt "ADSP RPC version"

	default AMSS_7X25_VERSION_2009

	config AMSS_7X25_VERSION_2009
	        bool "2.0.09"

	config AMSS_7X25_VERSION_2008
	        bool "2.0.08"
endchoice

config MSM7KV2_AUDIO
	bool "MSM7K v2 audio"
	depends on ARCH_MSM7X30
	default y
	help
	  Enables QDSP5V2-based audio drivers for audio playbacks and
	  voice call.

config MSM_ADSP_REPORT_EVENTS
	bool "Report modem events from the DSP"
	default y
	depends on (MSM_ADSP || MSM7KV2_AUDIO)
	help
	  Normally, only messages from the aDSP are reported to userspace.
	  With this option, we report events from the aDSP as well.

config MSM_QDSP6
	tristate "QDSP6 support"
	depends on ARCH_QSD8X50 && ANDROID_PMEM
	default y
	help
	  Enable support for qdsp6. This provides audio and video functionality.
       
endif

config QSD_AUDIO
	bool "QSD audio"
	depends on ARCH_MSM_SCORPION && MSM_DALRPC && ANDROID_PMEM && !MSM_SMP
	default y
	help
	  Provides PCM, MP3, and AAC audio playback.

config AUDIO_AAC_PLUS
	depends on (MSM_ADSP || QSD_AUDIO || MSM7KV2_AUDIO)
	bool "AAC+ Audio"
	default y
	help
	  Provides AAC+ decoding

config AUDIO_ENHANCED_AAC_PLUS
	depends on AUDIO_AAC_PLUS
	bool "Enhanced AAC+ Audio"
	default y
	help
	  Provides Enhanced AAC+ decoding
```

## drivers/video/fbdev/mdp/Kconfig
```kconfig
menu "MSM MDP display driver"
	depends on FB_MSM

config FB_MSM_LCDC
	bool
	default n

config FB_MSM_LCDC_HW
	bool
	default n

config FB_MSM_LCDC_PANEL
	bool
	select FB_MSM_LCDC
	default n

config FB_MSM_LCDC_S6E63M0_WVGA
	bool
	select FB_MSM_LCDC_PANEL
	default n

config FB_MSM_MDP_HW
	bool
	default n

choice
	prompt "MDP HW version"
	default FB_MSM_MDP22

config FB_MSM_MDP22
	select FB_MSM_MDP_HW
	bool "MDP HW ver2.2"
	---help---
	  Support for MSM MDP HW revision 2.2
	  Say Y here if this is msm7201 variant platform.

config FB_MSM_MDP30
	select FB_MSM_LCDC_HW
	bool "MDP HW ver3.0"
	---help---
	  Support for MSM MDP HW revision 3.0
	  Say Y here if this is msm7x25 variant platform.

config FB_MSM_MDP303
	depends on FB_MSM_MDP30
	select FB_MSM_MDP_HW
	bool "MDP HW ver3.03"
	default n
	---help---
	  Support for MSM MDP HW revision 3.03. This is a new version of
	  MDP3.0 which has the required functionality to support the features
	  required for msm7x2xA platform.
	  Say Y here if this is msm7x2xA variant platform.

config FB_MSM_MDP31
	select FB_MSM_LCDC_HW
	select FB_MSM_MDP_HW
	bool "MDP HW ver3.1"
	---help---
	  Support for MSM MDP HW revision 3.1
	  Say Y here if this is msm8x50 variant platform.

config FB_MSM_MDP40
	select FB_MSM_LCDC_HW
	select FB_MSM_MDP_HW
	bool "MDP HW ver4.0"
	---help---
	  Support for MSM MDP HW revision 4.0
	  Say Y here if this is msm7x30 variant platform.

config FB_MSM_MDP_NONE
	bool "MDP HW None"
	---help---
	  Say Y here if this is mdm platform.

endchoice

config FB_MSM_OVERLAY
	depends on FB_MSM_MDP40
	bool "MDP4 overlay support"
	default n

config FB_MSM_NO_MDP_PIPE_CTRL
	depends on FB_MSM_OVERLAY
	bool "Do not use mdp_pipe_ctrl"
	---help---
	  Saying 'Y' here obsoletes the mdp_pipe_ctrl function,
	  which was used to control mdp-related clocks. MDP4 vsync-driven
	  screen updates will use a different clock control mechanism if
	  this is selected.
choice
	prompt "LCD Panel"
	
	
config FB_MSM_LCDC_S6E63M0_WVGA_PANEL
	depends on FB_MSM_LCDC_HW
	bool "LCDC S6E63M0 WVGA Panel"
	select FB_MSM_LCDC_S6E63M0_WVGA
	---help---
	  Support for LCDC Samsung S6E63M0 WVGA (480x800) panel

endchoice


choice
	depends on  (FB_MSM_MDP22 || FB_MSM_MDP31 || FB_MSM_MDP40)
	prompt "TVOut Region"
	default FB_MSM_TVOUT_NONE

config FB_MSM_TVOUT_NTSC_M
	bool "NTSC M"
	select FB_MSM_TVOUT
        select FB_MSM_EXT_INTERFACE_COMMON
	---help---
	  Support for NTSC M region (North American and Korea)

config FB_MSM_TVOUT_NTSC_J
	bool "NTSC J"
	select FB_MSM_TVOUT
        select FB_MSM_EXT_INTERFACE_COMMON
	---help---
	  Support for NTSC J region (Japan)

config FB_MSM_TVOUT_PAL_BDGHIN
	bool "PAL BDGHIN"
	select FB_MSM_TVOUT
        select FB_MSM_EXT_INTERFACE_COMMON
	---help---
	  Support for PAL BDGHIN region (Non-argentina PAL-N)

config FB_MSM_TVOUT_PAL_M
	bool "PAL M"
	select FB_MSM_TVOUT
        select FB_MSM_EXT_INTERFACE_COMMON
	---help---
	  Support for PAL M region

config FB_MSM_TVOUT_PAL_N
	bool "PAL N"
	select FB_MSM_TVOUT
        select FB_MSM_EXT_INTERFACE_COMMON
	---help---
	  Support for PAL N region (Argentina PAL-N)

config FB_MSM_TVOUT_NONE
	bool "NONE"
	---help---
	  This will disable TV Out functionality.
endchoice

choice
	prompt "Default framebuffer color depth"
	depends on FB_MSM_MDP40 || FB_MSM_MDP31 || FB_MSM_MDP303
	default FB_MSM_DEFAULT_DEPTH_RGBA8888

config FB_MSM_DEFAULT_DEPTH_RGB565
	bool "16 bits per pixel (RGB565)"

config FB_MSM_DEFAULT_DEPTH_ARGB8888
	bool "32 bits per pixel (ARGB8888)"

config FB_MSM_DEFAULT_DEPTH_RGBA8888
	bool "32 bits per pixel (RGBA8888)"

endchoice

endmenu
```
